## boards/shields/kestrel/Kconfig.defconfig
```kconfig
if SHIELD_KESTREL_LEFT || SHIELD_KESTREL_RIGHT

config ZMK_KEYBOARD_NAME
    default "Kestrel KB_R"

config ZMK_SPLIT
    default y

config ZMK_BATTERY_REPORTING
    default y

config ZMK_SLEEP
    default y

config ZMK_PM_SOFT_OFF
    default y

config ZMK_DEFAULT_LAYER
    int
    default 0

endif

if SHIELD_KESTREL_RIGHT

config PMW3610
    bool
    default y
config ZMK_POINTING
    default y
config SPI
    default y

endif
```

## boards/shields/kestrel/Kconfig.shield
```kconfig
config SHIELD_KESTREL_LEFT
   def_bool $(shields_list_contains,kestrel_left)

config SHIELD_KESTREL_RIGHT
   def_bool $(shields_list_contains,kestrel_right)
```

## config/west.yml
```yaml
manifest:
  remotes:
    - name: zmkfirmware
      url-base: https://github.com/zmkfirmware
    - name: hnbn
      url-base: https://github.com/HNBN9

  projects:
    - name: zmk
      remote: zmkfirmware
      revision: main
      path: zmk
      import: app/west.yml

    - name: zmk-pmw3610-driver
      remote: hnbn
      revision: main
      path: modules/zmk-pmw3610-driver

  self:
    path: config
```
